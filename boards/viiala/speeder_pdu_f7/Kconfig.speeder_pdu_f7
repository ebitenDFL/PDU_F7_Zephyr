## boards/viiala/speeder_pdu_f7/Kconfig.speeder_pdu_f7
```kconfig
# SPDX-License-Identifier: Apache-2.0

config BOARD_SPEEDER_PDU_F7
	select SOC_STM32F722XX
```

## boards/viiala/speeder_pdu_f7/board.yml
```yaml
board:
  name: speeder_pdu_f7
  full_name: Speeder Legacy PDU STM32F722RC
  vendor: viiala
  socs:
    - name: stm32f722xx
```
